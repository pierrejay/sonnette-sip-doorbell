## bsp/rockchip_rk3506_sonnette_defconfig
```kconfig
#include "base/base.config"
#include "fs/vfat.config"
#include "multimedia/audio.config"
#include "lvgl/lvgl_rkadk.config"
#include "fs/ubifs.config"
# Override UBI geometry for XTX XT26G04C (4KB pages, 256KB blocks)
# PEB = 256KB = 0x40000
# LEB = PEB - 2 * page = 256KB - 8KB = 248KB = 0x3E000
BR2_TARGET_ROOTFS_UBI_MINIOSIZE=0x1000
BR2_TARGET_ROOTFS_UBI_PEBSIZE=0x40000
BR2_TARGET_ROOTFS_UBI_SUBSIZE=4096
BR2_TARGET_ROOTFS_UBIFS_LEBSIZE=0x3e000
BR2_TARGET_ROOTFS_UBIFS_MINIOSIZE=0x1000
BR2_PACKAGE_AVAHI=y
BR2_PACKAGE_AVAHI_DAEMON=y
BR2_PACKAGE_BIND=y
BR2_PACKAGE_BIND_TOOLS=y
BR2_PACKAGE_CAN_UTILS=y
BR2_PACKAGE_CA_CERTIFICATES=y
BR2_PACKAGE_COREUTILS=y
BR2_PACKAGE_DIALOG=y
BR2_PACKAGE_DNSMASQ=y
BR2_PACKAGE_DTC=y
BR2_PACKAGE_DTC_PROGRAMS=y
BR2_PACKAGE_EVTEST=y
BR2_PACKAGE_FFMPEG=y
BR2_PACKAGE_FFMPEG_AVRESAMPLE=y
BR2_PACKAGE_FFMPEG_FFPLAY=y
BR2_PACKAGE_FFMPEG_FFPROBE=y
BR2_PACKAGE_FFMPEG_GPL=y
BR2_PACKAGE_FFMPEG_POSTPROC=y
BR2_PACKAGE_FINDUTILS=y
BR2_PACKAGE_FREETYPE=y
BR2_PACKAGE_GIT=y
BR2_PACKAGE_GREP=y
BR2_PACKAGE_GZIP=y
BR2_PACKAGE_HOSTAPD=y
BR2_PACKAGE_HOSTAPD_EAP=y
BR2_PACKAGE_HOST_DTC=y
BR2_PACKAGE_HOST_LINUX_HEADERS_CUSTOM_6_1=y
BR2_PACKAGE_HTOP=y
BR2_PACKAGE_IOTOP=y
BR2_PACKAGE_IPERF3=y
BR2_PACKAGE_IPROUTE2=y
BR2_PACKAGE_IPTABLES=y
BR2_PACKAGE_IPUTILS=y
BR2_PACKAGE_IW=y
BR2_PACKAGE_LIBCAP=y
BR2_PACKAGE_LIBCURL=y
BR2_PACKAGE_LIBCURL_CURL=y
BR2_PACKAGE_LIBEVDEV=y
BR2_PACKAGE_LIBJPEG=y
BR2_PACKAGE_LIBOPENSSL=y
BR2_PACKAGE_LIBOPENSSL_BIN=y
BR2_PACKAGE_LINUX_FIRMWARE=y
BR2_PACKAGE_LINUX_FIRMWARE_RTL_81XX=y
BR2_PACKAGE_LOGROTATE=y
BR2_PACKAGE_LSOF=y
# BR2_PACKAGE_LVGL is reset to default
BR2_PACKAGE_MBPOLL=y
BR2_PACKAGE_MHZ=y
BR2_PACKAGE_MINICOM=y
BR2_PACKAGE_NANO=y
BR2_PACKAGE_NANOCOM=y
BR2_PACKAGE_NETCAT_OPENBSD=y
BR2_PACKAGE_NMAP=y
BR2_PACKAGE_NTP=y
BR2_PACKAGE_OPENSSH=y
BR2_PACKAGE_OPENSSH_GEN_KEYS=y
BR2_PACKAGE_PCRE2_16=y
BR2_PACKAGE_PCRE2_32=y
BR2_PACKAGE_PHYTOOL=y
BR2_PACKAGE_PICOCOM=y
BR2_PACKAGE_PPPD=y
BR2_PACKAGE_PPPD_FILTER=y
# BR2_PACKAGE_PULSEAUDIO is reset to default
BR2_PACKAGE_PYTHON3=y
BR2_PACKAGE_PYTHON3_SSL=y
BR2_PACKAGE_PYTHON_AIOHTTP=y
BR2_PACKAGE_PYTHON_CANOPEN=y
BR2_PACKAGE_PYTHON_CLICK=y
BR2_PACKAGE_PYTHON_ITSDANGEROUS=y
BR2_PACKAGE_PYTHON_JINJA2=y
BR2_PACKAGE_PYTHON_PERIPHERY=y
BR2_PACKAGE_PYTHON_PILLOW=y
BR2_PACKAGE_PYTHON_SERIAL=y
BR2_PACKAGE_PYTHON_SETUPTOOLS=y
BR2_PACKAGE_PYTHON_SMBUS_CFFI=y
BR2_PACKAGE_PYTHON_SPIDEV=y
BR2_PACKAGE_PYTHON_WERKZEUG=y
BR2_PACKAGE_RIPGREP=y
BR2_PACKAGE_RK3506=y
BR2_PACKAGE_RKADK=y
BR2_PACKAGE_RKADK_DISPLAY=y
BR2_PACKAGE_RKADK_EXAMPLES=y
BR2_PACKAGE_RKADK_PLAYER=y
BR2_PACKAGE_RKWIFIBT_APP=y
BR2_PACKAGE_ROCKCHIP_RGA=y
BR2_PACKAGE_ROCKCHIP_TEST=y
BR2_PACKAGE_SED=y
BR2_PACKAGE_STRACE=y
BR2_PACKAGE_STRESS_NG=y
BR2_PACKAGE_TCPDUMP=y
BR2_PACKAGE_UNZIP=y
BR2_PACKAGE_UTIL_LINUX_AGETTY=y
BR2_PACKAGE_VIM=y
BR2_PACKAGE_WGET=y
BR2_PACKAGE_WIREGUARD_TOOLS=y
BR2_PACKAGE_WIRELESS_TOOLS=y
BR2_PACKAGE_WPA_SUPPLICANT_WEXT=y
BR2_PACKAGE_XZ=y
BR2_PACK_EXTRA_TARGET=y
# BR2_PREFER_ROCKCHIP_RGA is not set
BR2_ROCKCHIP_ALSA_CONFIG_INSTALL_INIT_SCRIPT=y
BR2_TARGET_GENERIC_HOSTNAME="sonnette"
BR2_TARGET_GENERIC_ISSUE="Sonnette"
# BR2_TARGET_GENERIC_REMOUNT_ROOTFS_RW is not set
BR2_TARGET_GENERIC_ROOT_PASSWD="luckfox"
BR2_TARGET_LOCALTIME="Europe/Paris"
BR2_TARGET_ROOTFS_SQUASHFS4_ZSTD=y
BR2_TARGET_SERIAL_SHELL_GETTY=y
BR2_TIME_BITS_64=y
BR2_arm=y
BR2_cortex_a7=y
```
