// SPDX-License-Identifier: (GPL-2.0-or-later OR MIT)
/*
 * Custom Sonnette Board - RK3506G2
 * Smart doorbell: PDM mic + I2S speaker + GPIO button
 */

/dts-v1/;

#include "rk3506-custom-sonnette.dtsi"

/ {
	model = "Custom Sonnette RK3506G2";
	compatible = "custom,rk3506g-sonnette", "rockchip,rk3506";

	chosen {
		bootargs = "earlycon=uart8250,mmio32,0xff0a0000 console=ttyFIQ0 root=ubi0:rootfs ubi.mtd=2 rootfstype=ubifs rootwait";
	};
};
